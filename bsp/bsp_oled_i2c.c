#include "bsp_oled_i2c.h"
#include "i2c.h"
#include <string.h>
#define OLED_ADDR   0x78U
#define OLED_WIDTH  128
#define OLED_PAGES  8

static uint8_t oled_buf[OLED_PAGES][OLED_WIDTH];

/* ------------------------- 底层 I2C 写入 ------------------------- */
static void oled_write_cmd(uint8_t cmd)
{
    uint8_t buf[2] = {0x00, cmd};
    HAL_I2C_Master_Transmit(&hi2c2, OLED_ADDR, buf, 2, 100);
}

static void oled_write_data_burst(const uint8_t *data, uint16_t len)
{
    uint8_t buf[OLED_WIDTH + 1];
    buf[0] = 0x40;   /* 数据控制字 */
    memcpy(&buf[1], data, len);
    HAL_I2C_Master_Transmit(&hi2c2, OLED_ADDR, buf, len + 1, 100);
}

/* ------------------------- 6x8 ASCII 字库 (0x20~0x7E) ------------------------- */
static const uint8_t font6x8[][6] =
{
    {0x00,0x00,0x00,0x00,0x00,0x00}, /*   */
    {0x00,0x00,0x5F,0x00,0x00,0x00}, /* ! */
    {0x00,0x07,0x00,0x07,0x00,0x00}, /* " */
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    {0x08,0x04,0x08,0x10,0x08,0x00}, /* ~ */
};

/* ------------------------- 初始化 ------------------------- */
void bsp_oled_i2c_init(void)
{
    uint8_t init_seq[] =
    {
        0xAE,             /* display off */
        0xD5, 0x80,       /* clock divide */
        0xA8, 0x3F,       /* multiplex 1/64 */
        0xD3, 0x00,       /* display offset 0 */
        0x40,             /* start line 0 */
        0x8D, 0x14,       /* charge pump on */
        0x20, 0x02,       /* page addressing mode */
        0xA1,             /* segment remap */
        0xC8,             /* COM scan direction */
        0xDA, 0x12,       /* COM pins */
        0x81, 0xCF,       /* contrast */
        0xD9, 0xF1,       /* precharge */
        0xDB, 0x40,       /* VCOM detect */
        0xA4,             /* display all on resume */
        0xA6,             /* normal display */
        0xAF,             /* display on */
    };

    for (uint8_t i = 0; i < sizeof(init_seq); i++)
        oled_write_cmd(init_seq[i]);

    bsp_oled_i2c_clear();
    bsp_oled_i2c_flush();
}

/* ------------------------- 显存操作 ------------------------- */
void bsp_oled_i2c_clear(void)
{
    memset(oled_buf, 0x00, sizeof(oled_buf));
}

static void oled_draw_char(uint8_t x, uint8_t page, char c)
{
    if (c < 0x20 || c > 0x7E)
        c = ' ';

    const uint8_t *glyph = font6x8[c - 0x20];

    for (uint8_t i = 0; i < 6; i++)
    {
        if ((x + i) < OLED_WIDTH)
            oled_buf[page][x + i] = glyph[i];
    }
}

void bsp_oled_i2c_show_str(uint8_t x, uint8_t page, const char *str)
{
    while (*str != '\0' && x < OLED_WIDTH)
    {
        oled_draw_char(x, page, *str);
        x += 6;
        str++;
    }
}

void bsp_oled_i2c_show_num(uint8_t x, uint8_t page, int32_t num, uint8_t len)
{
    char buf[12];
    uint8_t i = 0;
    uint8_t neg = 0;

    if (num < 0)
    {
        neg = 1;
        num = -num;
    }

    do
    {
        buf[i++] = (char)('0' + (num % 10));
        num /= 10;
    } while (num != 0 && i < 11);

    while (i < len)
        buf[i++] = '0';

    if (neg && i < 11)
        buf[i++] = '-';

    while (i > 0)
    {
        oled_draw_char(x, page, buf[--i]);
        x += 6;
    }
}

/* ------------------------- 刷新到屏幕 ------------------------- */
void bsp_oled_i2c_flush(void)
{
    for (uint8_t page = 0; page < OLED_PAGES; page++)
    {
        oled_write_cmd(0xB0 + page);
        oled_write_cmd(0x00);
        oled_write_cmd(0x10);
        oled_write_data_burst(oled_buf[page], OLED_WIDTH);
    }
}
